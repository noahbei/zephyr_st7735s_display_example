//#include <zephyr/dt-bindings/mipi_dsi/mipi_dsi.h>

/ {
    chosen {
        zephyr,display = &st7735r;
    };
};
&spi1 {
    status = "okay";
    cs-gpios = <&gpio0 6 GPIO_ACTIVE_LOW>;
    st7735r: st7735r@0 {
        compatible = "sitronix,st7735r";
        reg = <0>;
        // label = "ST7735R";
        spi-max-frequency = <DT_FREQ_M(8)>;
        width = <128>;
        height = <128>;
        x-offset = <3>;
		y-offset = <2>;
        madctl = <0x60>;
        colmod = <0x55>;
        vmctr1 = <0x0e>;
        pwctr1 = [a2 02 84];
        pwctr2 = [c5];
        pwctr3 = [0a 00];
        pwctr4 = [8a 2a];
        pwctr5 = [8a ee];
        frmctr1 = [01 2c 2d];
        frmctr2 = [01 2c 2d];
        frmctr3 = [01 2c 2d 01 2c 2d];
        gamctrp1 = [02 1c 07 12 37 32 29 2d 29 25 2b 39 00 01 03 10];
        gamctrn1 = [03 1d 07 06 2e 2c 29 2d 2e 2e 37 3f 00 00 02 10];
        reset-gpios = <&gpio1 4 GPIO_ACTIVE_LOW>;
        cmd-data-gpios = <&gpio1 5 GPIO_ACTIVE_LOW>;
    };
};
